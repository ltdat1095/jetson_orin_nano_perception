## build/conf/bblayers.conf
```bitbake
# POKY_BBLAYERS_CONF_VERSION is increased each time build/conf/bblayers.conf
# changes incompatibly
POKY_BBLAYERS_CONF_VERSION = "2"

BBPATH = "${TOPDIR}"
BBFILES ?= ""

# BBLAYERS ?= " \
#   ${BBPATH}/../poky/meta \
#   ${BBPATH}/../poky/meta-poky \
#   ${BBPATH}/../poky/meta-yocto-bsp \
#   ${BBPATH}/../meta-tegra \
#   ${BBPATH}/../meta-tegra-community \
#   ${BBPATH}/../meta-mender/meta-mender-core \
#   ${BBPATH}/../meta-mender-community/meta-mender-tegra/meta-mender-tegra-common \
#   ${BBPATH}/../meta-mender-community/meta-mender-tegra/meta-mender-tegra-jetpack6 \
#   ${BBPATH}/../meta-openembedded/meta-networking \
#   ${BBPATH}/../meta-openembedded/meta-python \
#   ${BBPATH}/../meta-openembedded/meta-oe \
#   ${BBPATH}/../meta-perception \
#   ${BBPATH}/../meta-ros/meta-ros-common \
#   ${BBPATH}/../meta-ros/meta-ros2 \
#   ${BBPATH}/../meta-ros/meta-ros2-humble \
#   "


BBLAYERS ?= " \
  ${TOPDIR}/../poky/meta \
  ${TOPDIR}/../poky/meta-poky \
  ${TOPDIR}/../poky/meta-yocto-bsp \
  ${TOPDIR}/../meta-tegra \
  ${TOPDIR}/../meta-tegra-community \
  ${TOPDIR}/../meta-mender/meta-mender-core \
  ${TOPDIR}/../meta-mender-community/meta-mender-tegra/meta-mender-tegra-common \
  ${TOPDIR}/../meta-mender-community/meta-mender-tegra/meta-mender-tegra-jetpack6 \
  ${TOPDIR}/../meta-openembedded/meta-oe \
  ${TOPDIR}/../meta-openembedded/meta-networking \
  ${TOPDIR}/../meta-openembedded/meta-python \
  ${TOPDIR}/../meta-perception \
  ${TOPDIR}/../meta-ros/meta-ros-common \
  ${TOPDIR}/../meta-ros/meta-ros2 \
  ${TOPDIR}/../meta-ros/meta-ros2-humble \
"
```

## build/conf/local.conf
```bitbake
MACHINE = "jetson-orin-super"
DISTRO = "nano-perception"

#
# Extra image configuration defaults
#
# The EXTRA_IMAGE_FEATURES variable allows extra packages to be added to the generated
# images. Some of these options are added to certain image types automatically. The
# variable can contain the following options:
#  "dbg-pkgs"       - add -dbg packages for all installed packages
#                     (adds symbol information for debugging/profiling)
#  "src-pkgs"       - add -src packages for all installed packages
#                     (adds source code for debugging)
#  "dev-pkgs"       - add -dev packages for all installed packages
#                     (useful if you want to develop against libs in the image)
#  "ptest-pkgs"     - add -ptest packages for all ptest-enabled packages
#                     (useful if you want to run the package test suites)
#  "tools-sdk"      - add development tools (gcc, make, pkgconfig etc.)
#  "tools-debug"    - add debugging tools (gdb, strace)
#  "eclipse-debug"  - add Eclipse remote debugging support
#  "tools-profile"  - add profiling tools (oprofile, lttng, valgrind)
#  "tools-testapps" - add useful testing tools (ts_print, aplay, arecord etc.)
#  "debug-tweaks"   - make an image suitable for development
#                     e.g. ssh root access has a blank password
# There are other application targets that can be used here too, see
# meta/classes-recipe/image.bbclass and
# meta/classes-recipe/core-image.bbclass for more details.
# We default to enabling the debugging tweaks.
EXTRA_IMAGE_FEATURES ?= "debug-tweaks"
USER_CLASSES ?= "buildstats"
PATCHRESOLVE = "noop"
BB_DISKMON_DIRS ??= "\
    STOPTASKS,${TMPDIR},1G,100K \
    STOPTASKS,${DL_DIR},1G,100K \
    STOPTASKS,${SSTATE_DIR},1G,100K \
    STOPTASKS,/tmp,100M,100K \
    HALT,${TMPDIR},100M,1K \
    HALT,${DL_DIR},100M,1K \
    HALT,${SSTATE_DIR},100M,1K \
    HALT,/tmp,10M,1K"
PACKAGECONFIG:append:pn-qemu-system-native = " sdl"

CONF_VERSION = "2"
BB_NUMBER_THREADS = "6" 
PARALLEL_MAKE = "-j 6"
```

## meta-perception/conf/distro/nano-perception.conf
```bitbake
require conf/distro/poky.conf

DISTRO = "nano-perception"
DISTRO_NAME = "Nano Perception Linux"
DISTRO_VERSION = "1.0"

# --------------------------------------------------
# Init system
# --------------------------------------------------
DISTRO_FEATURES:append = " systemd usrmerge"
DISTRO_FEATURES:remove = " sysvinit"
DISTRO_FEATURES_BACKFILL_CONSIDERED:append = " sysvinit"

VIRTUAL-RUNTIME_init_manager = "systemd"
VIRTUAL-RUNTIME_initscripts = ""
VIRTUAL-RUNTIME_network_manager = "systemd-networkd"
PACKAGECONFIG:append:pn-systemd = " coredump"

# --------------------------------------------------
# Toolchain / libc
# --------------------------------------------------
LIBC_EXTENSION_multilib = ""

# --------------------------------------------------
# A/B boot (Jetson extlinux)
# --------------------------------------------------
UBOOT_EXTLINUX = "1"
USE_REDUNDANT_FLASH_LAYOUT_DEFAULT = "1"
IMAGE_INSTALL:remove = "tegra-uefi-capsules tegra-uefi-capsule-tools"
RDEPENDS:remove:pn-l4t-launcher-extlinux = "tegra-uefi-capsules"

# --------------------------------------------------
# Base image
# --------------------------------------------------
CONF_VERSION = "2"
PACKAGE_CLASSES = "package_ipk"
INIT_MANAGER = "systemd"
EXTRA_IMAGE_FEATURES ?= "debug-tweaks"

# --------------------------------------------------
# Mender artifact
# --------------------------------------------------
MENDER_ARTIFACT_NAME = "jetson-orin-perception"
INHERIT:remove = "tegra-support-sanity distro_layer_buildinfo create-spdx"
INHERIT += "mender-full report-error rm_work"
INHERIT:append:tegra = " tegra-mender-setup"
MENDER_FEATURES_DISABLE:append = " mender-uboot"
IMAGE_FSTYPES:tegra = "tegraflash mender"
IMAGE_FSTYPES:pn-tegra-minimal-initramfs:tegra = "${INITRAMFS_FSTYPES}"
IMAGE_FSTYPES:pn-tegra-initrd-flash-initramfs:tegra = "${TEGRA_INITRD_FLASH_INITRAMFS_FSTYPES}"

# --------------------------------------------------
# Serial Console
# --------------------------------------------------
# Enable login on USB gadget serial (ACM)
SERIAL_CONSOLES:append = " 115200;ttyGS0"

# --------------------------------------------------
# Generate deb package
# --------------------------------------------------
PACKAGE_CLASSES = "package_deb"
IMAGE_FEATURES += "package-management"

#--------------------------------------------------
# Nvidia license
# --------------------------------------------------
ACCEPT_NVIDIA_EULA = "1"
LICENSE_FLAGS_ACCEPTED += "commercial"

#--------------------------------------------------
# ROS2 Humble
# --------------------------------------------------
ROS_OE_RELEASE_SERIES = "scarthgap"
ROS_DISTRO = "humble"

#--------------------------------------------------
# Package conflict
# --------------------------------------------------
PREFERRED_RPROVIDER_mender-auth = "mender"
PREFERRED_RPROVIDER_mender-update = "mender"
PREFERRED_PROVIDER_mender-native = "mender-native"
PREFERRED_VERSION_yaml-cpp = "0.8.0"
PREFERRED_PROVIDER_yaml-cpp = "yaml-cpp"
```

## meta-perception/conf/distro/perception.conf
```bitbake
require conf/distro/poky.conf

DISTRO = "perception"
DISTRO_NAME = "Perception Linux"
DISTRO_VERSION = "1.0"

# --------------------------------------------------
# Init system
# --------------------------------------------------
DISTRO_FEATURES:append = " systemd usrmerge"
DISTRO_FEATURES:remove = " sysvinit"
DISTRO_FEATURES_BACKFILL_CONSIDERED:append = " sysvinit"

VIRTUAL-RUNTIME_init_manager = "systemd"
VIRTUAL-RUNTIME_initscripts = ""
VIRTUAL-RUNTIME_network_manager = "systemd-networkd"
PACKAGECONFIG:append:pn-systemd = " coredump"

# --------------------------------------------------
# Toolchain / libc
# --------------------------------------------------
LIBC_EXTENSION_multilib = ""

# --------------------------------------------------
# A/B boot (Jetson extlinux)
# --------------------------------------------------
UBOOT_EXTLINUX = "1"
USE_REDUNDANT_FLASH_LAYOUT_DEFAULT = "1"
IMAGE_INSTALL:remove = "tegra-uefi-capsules tegra-uefi-capsule-tools"
RDEPENDS:remove:pn-l4t-launcher-extlinux = "tegra-uefi-capsules"

# --------------------------------------------------
# Base image
# --------------------------------------------------
CONF_VERSION = "2"
PACKAGE_CLASSES = "package_ipk"
INIT_MANAGER = "systemd"
EXTRA_IMAGE_FEATURES ?= "debug-tweaks"

# --------------------------------------------------
# Mender artifact
# --------------------------------------------------
MENDER_ARTIFACT_NAME = "gha_autobuild"
INHERIT:remove = "tegra-support-sanity distro_layer_buildinfo"
INHERIT += "mender-full"
INHERIT:append:tegra = " tegra-mender-setup"
MENDER_FEATURES_DISABLE:append = " mender-uboot"
IMAGE_FSTYPES:tegra = "tegraflash mender"
IMAGE_FSTYPES:pn-tegra-minimal-initramfs:tegra = "${INITRAMFS_FSTYPES}"
IMAGE_FSTYPES:pn-tegra-initrd-flash-initramfs:tegra = "${TEGRA_INITRD_FLASH_INITRAMFS_FSTYPES}"

# --------------------------------------------------
# Serial Console
# --------------------------------------------------
# Enable login on USB gadget serial (ACM)
SERIAL_CONSOLES:append = " 115200;ttyGS0"

# --------------------------------------------------
# Generate deb package
# --------------------------------------------------
PACKAGE_CLASSES = "package_deb"
IMAGE_FEATURES += "package-management"

#--------------------------------------------------
# Kernel
# --------------------------------------------------
MACHINE_ESSENTIAL_EXTRA_RDEPENDS += "\
    nvidia-kernel-oot-alsa \
    nvidia-kernel-oot-display \
    nvidia-kernel-oot-cameras \
"
```

## meta-perception/conf/layer.conf
```bitbake
# We have a conf and classes directory, add to BBPATH
BBPATH .= ":${LAYERDIR}"

# We have recipes-* directories, add to BBFILES
BBFILES += "${LAYERDIR}/recipes-*/*/*.bb \
            ${LAYERDIR}/recipes-*/*/*.bbappend"

BBFILE_COLLECTIONS += "meta-perception"
BBFILE_PATTERN_meta-perception = "^${LAYERDIR}/"
BBFILE_PRIORITY_meta-perception = "6"

LAYERDEPENDS_meta-perception = "core"
LAYERSERIES_COMPAT_meta-perception = "scarthgap"
```

## meta-perception/conf/machine/jetson-orin-super.conf
```bitbake
require conf/machine/jetson-orin-nano-devkit-nvme.conf

# --------------------------------------------------
# Machine name
# --------------------------------------------------
MACHINEOVERRIDES =. "jetson-orin-super:"
COMPATIBLE_MACHINE:jetson-orin-super = "jetson-orin-super"

# --------------------------------------------------
# Custom DTB
# --------------------------------------------------
PREFERRED_PROVIDER_virtual/dtb = "perception-devicetree"
KERNEL_DEVICETREE = "tegra234-p3768-0000+p3767-0005-perception.dtb"

#--------------------------------------------------
# Storage
# --------------------------------------------------
# Not using eMMC
EMMC_SIZE = "0"

# --------------------------------------------------
# Mender partition
# --------------------------------------------------
MENDER_STORAGE_DEVICE_BASE = "/dev/nvme0n1p"
MENDER_STORAGE_TOTAL_SIZE_MB = "20000"
MENDER_ROOTFS_PART_A = "${MENDER_STORAGE_DEVICE_BASE}1"
MENDER_ROOTFS_PART_B = "${MENDER_STORAGE_DEVICE_BASE}2"
MENDER_BOOT_PART = "${MENDER_STORAGE_DEVICE_BASE}11"
MENDER_DATA_PART = "${MENDER_STORAGE_DEVICE_BASE}15"
MENDER_DATA_PART_SIZE_MB = "400"

# Extra storage
# MENDER_EXTRA_PARTS = "perception"
# MENDER_EXTRA_PARTS[perception] = "--label=perception --fstype=ext4"
# MENDER_EXTRA_PARTS_SIZES_MB[perception] = "230000"
# MENDER_EXTRA_PARTS_FSTAB[perception] = "ext4 defaults,noatime 0 2"
# MENDER_EXTRA_PARTS_MOUNT_LOCATIONS[perception] = "/mnt/perception"
```
